## micro_speech/build/Kconfig/Kconfig.modules
```kconfig
menu "tflite-micro (/home/fyd/gsoc-micro-speech-west/optional/modules/lib/tflite-micro)"
osource "$(ZEPHYR_TFLITE_MICRO_KCONFIG)"
config ZEPHYR_TFLITE_MICRO_MODULE
	bool
	default y
endmenu
menu "acpica (/home/fyd/gsoc-micro-speech-west/modules/lib/acpica)"
osource "$(ZEPHYR_ACPICA_KCONFIG)"
config ZEPHYR_ACPICA_MODULE
	bool
	default y
endmenu
menu "cmsis (/home/fyd/gsoc-micro-speech-west/modules/hal/cmsis)"
osource "$(ZEPHYR_CMSIS_KCONFIG)"
config ZEPHYR_CMSIS_MODULE
	bool
	default y
endmenu
menu "cmsis-dsp (/home/fyd/gsoc-micro-speech-west/modules/lib/cmsis-dsp)"
osource "$(ZEPHYR_CMSIS_DSP_KCONFIG)"
config ZEPHYR_CMSIS_DSP_MODULE
	bool
	default y
endmenu
menu "cmsis-nn (/home/fyd/gsoc-micro-speech-west/modules/lib/cmsis-nn)"
osource "$(ZEPHYR_CMSIS_NN_KCONFIG)"
config ZEPHYR_CMSIS_NN_MODULE
	bool
	default y
endmenu
menu "cmsis_6 (/home/fyd/gsoc-micro-speech-west/modules/hal/cmsis_6)"
osource "$(ZEPHYR_CMSIS_6_KCONFIG)"
config ZEPHYR_CMSIS_6_MODULE
	bool
	default y
endmenu
menu "fatfs (/home/fyd/gsoc-micro-speech-west/modules/fs/fatfs)"
osource "$(ZEPHYR_FATFS_KCONFIG)"
config ZEPHYR_FATFS_MODULE
	bool
	default y
endmenu
config ZEPHYR_ADI_MODULE
	bool
	default y
menu "hal_afbr (/home/fyd/gsoc-micro-speech-west/modules/hal/afbr)"
osource "$(ZEPHYR_HAL_AFBR_KCONFIG)"
config ZEPHYR_HAL_AFBR_MODULE
	bool
	default y

config ZEPHYR_HAL_AFBR_MODULE_BLOBS
	bool
endmenu
menu "hal_ambiq (/home/fyd/gsoc-micro-speech-west/modules/hal/ambiq)"
osource "$(ZEPHYR_HAL_AMBIQ_KCONFIG)"
config ZEPHYR_HAL_AMBIQ_MODULE
	bool
	default y
endmenu
config ZEPHYR_ATMEL_MODULE
	bool
	default y
menu "hal_bouffalolab (/home/fyd/gsoc-micro-speech-west/modules/hal/bouffalolab)"
osource "$(ZEPHYR_HAL_BOUFFALOLAB_KCONFIG)"
config ZEPHYR_HAL_BOUFFALOLAB_MODULE
	bool
	default y
endmenu
menu "hal_espressif (/home/fyd/gsoc-micro-speech-west/modules/hal/espressif)"
osource "/home/fyd/gsoc-micro-speech-west/modules/hal/espressif/zephyr/Kconfig"
config ZEPHYR_HAL_ESPRESSIF_MODULE
	bool
	default y

config ZEPHYR_HAL_ESPRESSIF_MODULE_BLOBS
	bool
endmenu
menu "hal_ethos_u (/home/fyd/gsoc-micro-speech-west/modules/hal/ethos_u)"
osource "$(ZEPHYR_HAL_ETHOS_U_KCONFIG)"
config ZEPHYR_HAL_ETHOS_U_MODULE
	bool
	default y
endmenu
menu "hal_gigadevice (/home/fyd/gsoc-micro-speech-west/modules/hal/gigadevice)"
osource "$(ZEPHYR_HAL_GIGADEVICE_KCONFIG)"
config ZEPHYR_HAL_GIGADEVICE_MODULE
	bool
	default y
endmenu
menu "hal_infineon (/home/fyd/gsoc-micro-speech-west/modules/hal/infineon)"
osource "$(ZEPHYR_HAL_INFINEON_KCONFIG)"
config ZEPHYR_HAL_INFINEON_MODULE
	bool
	default y

config ZEPHYR_HAL_INFINEON_MODULE_BLOBS
	bool
endmenu
menu "hal_intel (/home/fyd/gsoc-micro-speech-west/modules/hal/intel)"
osource "/home/fyd/gsoc-micro-speech-west/modules/hal/intel/zephyr/Kconfig"
config ZEPHYR_HAL_INTEL_MODULE
	bool
	default y
endmenu
config ZEPHYR_MICROCHIP_MODULE
	bool
	default y
menu "hal_nordic (/home/fyd/gsoc-micro-speech-west/modules/hal/nordic)"
osource "$(ZEPHYR_HAL_NORDIC_KCONFIG)"
config ZEPHYR_HAL_NORDIC_MODULE
	bool
	default y

config ZEPHYR_HAL_NORDIC_MODULE_BLOBS
	bool
endmenu
config ZEPHYR_NUVOTON_MODULE
	bool
	default y
menu "hal_nxp (/home/fyd/gsoc-micro-speech-west/modules/hal/nxp)"
osource "$(ZEPHYR_HAL_NXP_KCONFIG)"
config ZEPHYR_HAL_NXP_MODULE
	bool
	default y

config ZEPHYR_HAL_NXP_MODULE_BLOBS
	bool
endmenu
config ZEPHYR_OPENISA_MODULE
	bool
	default y
config ZEPHYR_QUICKLOGIC_MODULE
	bool
	default y
config ZEPHYR_HAL_RENESAS_MODULE
	bool
	default y

config ZEPHYR_HAL_RENESAS_MODULE_BLOBS
	bool
menu "hal_rpi_pico (/home/fyd/gsoc-micro-speech-west/modules/hal/rpi_pico)"
osource "$(ZEPHYR_HAL_RPI_PICO_KCONFIG)"
config ZEPHYR_HAL_RPI_PICO_MODULE
	bool
	default y
endmenu
menu "hal_sifli (/home/fyd/gsoc-micro-speech-west/modules/hal/sifli)"
osource "$(ZEPHYR_HAL_SIFLI_KCONFIG)"
config ZEPHYR_HAL_SIFLI_MODULE
	bool
	default y
endmenu
menu "hal_silabs (/home/fyd/gsoc-micro-speech-west/modules/hal/silabs)"
osource "$(ZEPHYR_HAL_SILABS_KCONFIG)"
config ZEPHYR_HAL_SILABS_MODULE
	bool
	default y

config ZEPHYR_HAL_SILABS_MODULE_BLOBS
	bool
endmenu
menu "hal_st (/home/fyd/gsoc-micro-speech-west/modules/hal/st)"
osource "$(ZEPHYR_HAL_ST_KCONFIG)"
config ZEPHYR_HAL_ST_MODULE
	bool
	default y
endmenu
config ZEPHYR_HAL_STM32_MODULE
	bool
	default y

config ZEPHYR_HAL_STM32_MODULE_BLOBS
	bool
menu "hal_tdk (/home/fyd/gsoc-micro-speech-west/modules/hal/tdk)"
osource "$(ZEPHYR_HAL_TDK_KCONFIG)"
config ZEPHYR_HAL_TDK_MODULE
	bool
	default y
endmenu
menu "hal_telink (/home/fyd/gsoc-micro-speech-west/modules/hal/telink)"
osource "/home/fyd/gsoc-micro-speech-west/modules/hal/telink/Kconfig"
config ZEPHYR_HAL_TELINK_MODULE
	bool
	default y
endmenu
config ZEPHYR_TI_MODULE
	bool
	default y
menu "hal_wch (/home/fyd/gsoc-micro-speech-west/modules/hal/wch)"
osource "$(ZEPHYR_HAL_WCH_KCONFIG)"
config ZEPHYR_HAL_WCH_MODULE
	bool
	default y
endmenu
config ZEPHYR_HAL_WURTHELEKTRONIK_MODULE
	bool
	default y
config ZEPHYR_XTENSA_MODULE
	bool
	default y
menu "hostap (/home/fyd/gsoc-micro-speech-west/modules/lib/hostap)"
osource "$(ZEPHYR_HOSTAP_KCONFIG)"
config ZEPHYR_HOSTAP_MODULE
	bool
	default y
endmenu
menu "liblc3 (/home/fyd/gsoc-micro-speech-west/modules/lib/liblc3)"
osource "$(ZEPHYR_LIBLC3_KCONFIG)"
config ZEPHYR_LIBLC3_MODULE
	bool
	default y
endmenu
config ZEPHYR_LIBMCTP_MODULE
	bool
	default y
config ZEPHYR_LIBMETAL_MODULE
	bool
	default y
menu "libsbc (/home/fyd/gsoc-micro-speech-west/modules/lib/libsbc)"
osource "$(ZEPHYR_LIBSBC_KCONFIG)"
config ZEPHYR_LIBSBC_MODULE
	bool
	default y
endmenu
menu "littlefs (/home/fyd/gsoc-micro-speech-west/modules/fs/littlefs)"
osource "$(ZEPHYR_LITTLEFS_KCONFIG)"
config ZEPHYR_LITTLEFS_MODULE
	bool
	default y
endmenu
menu "lora-basics-modem (/home/fyd/gsoc-micro-speech-west/modules/lib/lora-basics-modem)"
osource "$(ZEPHYR_LORA_BASICS_MODEM_KCONFIG)"
config ZEPHYR_LORA_BASICS_MODEM_MODULE
	bool
	default y
endmenu
menu "loramac-node (/home/fyd/gsoc-micro-speech-west/modules/lib/loramac-node)"
osource "$(ZEPHYR_LORAMAC_NODE_KCONFIG)"
config ZEPHYR_LORAMAC_NODE_MODULE
	bool
	default y
endmenu
menu "lvgl (/home/fyd/gsoc-micro-speech-west/modules/lib/gui/lvgl)"
osource "/home/fyd/gsoc-micro-speech-west/modules/lib/gui/lvgl/zephyr/Kconfig"
config ZEPHYR_LVGL_MODULE
	bool
	default y
endmenu
menu "mbedtls (/home/fyd/gsoc-micro-speech-west/modules/crypto/mbedtls)"
osource "$(ZEPHYR_MBEDTLS_KCONFIG)"
config ZEPHYR_MBEDTLS_MODULE
	bool
	default y
endmenu
config ZEPHYR_MCUBOOT_MODULE
	bool
	default y
config ZEPHYR_MIPI_SYS_T_MODULE
	bool
	default y
menu "nanopb (/home/fyd/gsoc-micro-speech-west/modules/lib/nanopb)"
osource "$(ZEPHYR_NANOPB_KCONFIG)"
config ZEPHYR_NANOPB_MODULE
	bool
	default y
endmenu
menu "nrf_wifi (/home/fyd/gsoc-micro-speech-west/modules/lib/nrf_wifi)"
osource "$(ZEPHYR_NRF_WIFI_KCONFIG)"
config ZEPHYR_NRF_WIFI_MODULE
	bool
	default y

config ZEPHYR_NRF_WIFI_MODULE_BLOBS
	bool
endmenu
config ZEPHYR_OPEN_AMP_MODULE
	bool
	default y
menu "openthread (/home/fyd/gsoc-micro-speech-west/modules/lib/openthread)"
osource "$(ZEPHYR_OPENTHREAD_KCONFIG)"
config ZEPHYR_OPENTHREAD_MODULE
	bool
	default y
endmenu
menu "percepio (/home/fyd/gsoc-micro-speech-west/modules/debug/percepio)"
osource "/home/fyd/gsoc-micro-speech-west/modules/debug/percepio/zephyr/Kconfig"
config ZEPHYR_PERCEPIO_MODULE
	bool
	default y
endmenu
menu "picolibc (/home/fyd/gsoc-micro-speech-west/modules/lib/picolibc)"
osource "/home/fyd/gsoc-micro-speech-west/modules/lib/picolibc/zephyr/Kconfig"
config ZEPHYR_PICOLIBC_MODULE
	bool
	default y
endmenu
menu "segger (/home/fyd/gsoc-micro-speech-west/modules/debug/segger)"
osource "$(ZEPHYR_SEGGER_KCONFIG)"
config ZEPHYR_SEGGER_MODULE
	bool
	default y
endmenu
menu "trusted-firmware-a (/home/fyd/gsoc-micro-speech-west/modules/tee/tf-a/trusted-firmware-a)"
osource "$(ZEPHYR_TRUSTED_FIRMWARE_A_KCONFIG)"
config ZEPHYR_TRUSTED_FIRMWARE_A_MODULE
	bool
	default y
endmenu
menu "trusted-firmware-m (/home/fyd/gsoc-micro-speech-west/modules/tee/tf-m/trusted-firmware-m)"
osource "$(ZEPHYR_TRUSTED_FIRMWARE_M_KCONFIG)"
config ZEPHYR_TRUSTED_FIRMWARE_M_MODULE
	bool
	default y
endmenu
menu "uoscore-uedhoc (/home/fyd/gsoc-micro-speech-west/modules/lib/uoscore-uedhoc)"
osource "$(ZEPHYR_UOSCORE_UEDHOC_KCONFIG)"
config ZEPHYR_UOSCORE_UEDHOC_MODULE
	bool
	default y
endmenu
menu "zcbor (/home/fyd/gsoc-micro-speech-west/modules/lib/zcbor)"
osource "$(ZEPHYR_ZCBOR_KCONFIG)"
config ZEPHYR_ZCBOR_MODULE
	bool
	default y
endmenu
config ZEPHYR_NRF_HW_MODELS_MODULE
	bool
	default y
```

## micro_speech/build/Kconfig/arch/Kconfig
```kconfig
# Load Zephyr Arch Kconfig descriptions.
osource "/home/fyd/gsoc-micro-speech-west/zephyr/arch/rx/Kconfig"
osource "/home/fyd/gsoc-micro-speech-west/zephyr/arch/x86/Kconfig"
osource "/home/fyd/gsoc-micro-speech-west/zephyr/arch/xtensa/Kconfig"
osource "/home/fyd/gsoc-micro-speech-west/zephyr/arch/sparc/Kconfig"
osource "/home/fyd/gsoc-micro-speech-west/zephyr/arch/riscv/Kconfig"
osource "/home/fyd/gsoc-micro-speech-west/zephyr/arch/posix/Kconfig"
osource "/home/fyd/gsoc-micro-speech-west/zephyr/arch/mips/Kconfig"
osource "/home/fyd/gsoc-micro-speech-west/zephyr/arch/arm64/Kconfig"
osource "/home/fyd/gsoc-micro-speech-west/zephyr/arch/arm/Kconfig"
osource "/home/fyd/gsoc-micro-speech-west/zephyr/arch/arc/Kconfig"
```

## micro_speech/build/Kconfig/boards/Kconfig.defconfig
```kconfig
# Load Zephyr board defconfig descriptions.
osource "/home/fyd/gsoc-micro-speech-west/zephyr/boards/nxp/imx8mp_evk/Kconfig.defconfig"
```

## micro_speech/build/Kconfig/boards/Kconfig.imx8mp_evk
```kconfig
# Load board Kconfig descriptions.
osource "/home/fyd/gsoc-micro-speech-west/zephyr/boards/nxp/imx8mp_evk/Kconfig.imx8mp_evk"
```

## micro_speech/build/Kconfig/boards/Kconfig.sysbuild
```kconfig
# Load Sysbuild board Kconfig descriptions.
osource "/home/fyd/gsoc-micro-speech-west/zephyr/boards/nxp/imx8mp_evk/Kconfig.sysbuild"
```
